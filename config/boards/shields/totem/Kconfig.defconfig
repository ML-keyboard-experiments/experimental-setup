## config/boards/shields/totem/Kconfig.defconfig
```kconfig
# Copyright (c) 2022 The ZMK Contributors
# SPDX-License-Identifier: MIT

if SHIELD_DONGLE || SHIELD_CENTRAL

config ZMK_KEYBOARD_NAME
    default "TOTEM"

config ZMK_SPLIT_ROLE_CENTRAL
    default y

endif

if SHIELD_PERIPHERAL || SHIELD_TESTING_BOARD || SHIELD_DONGLE || SHIELD_CENTRAL

config ZMK_SPLIT
    default y

config ZMK_BLE
    default y

endif
```

## config/boards/shields/totem/Kconfig.shield
```kconfig
# Copyright (c) 2022 The ZMK Contributors
# SPDX-License-Identifier: MIT

config SHIELD_PERIPHERAL
    def_bool $(shields_list_contains,peripheral)

config SHIELD_CENTRAL
    def_bool $(shields_list_contains,central)

config SHIELD_TESTING_BOARD
    def_bool $(shields_list_contains,testing_board)

config SHIELD_DONGLE
    def_bool $(shields_list_contains,dongle)
```

## config/west.yml
```yaml
manifest:
  remotes:
    - name: ML-keyboard-experiments
      url-base: https://github.com/ML-keyboard-experiments
    - name: zmkfirmware
      url-base: https://github.com/zmkfirmware

  projects:
    - name: zmk
      remote: ML-keyboard-experiments
      revision: experimental-profiling
      import: app/west.yml
    # - name: zephyr
    #   remote: zmkfirmware
    #   revision: v4.1.0+zmk-fixes
    #   clone-depth: 1
    #   import:
    #     name-allowlist:
    #       - cmsis
    #       - hal_nordic
    #       - hal_rpi_pico
    #       - hal_stm32
    #       - lvgl
    #       - tinycrypt

  self:
    path: config
```
